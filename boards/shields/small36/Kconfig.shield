## boards/shields/small36/Kconfig.shield
```kconfig
config SHIELD_SMALL36_LEFT
	def_bool $(shields_list_contains,small36_left)

config SHIELD_SMALL36_RIGHT
	def_bool $(shields_list_contains,small36_right)

if SHIELD_SMALL36_LEFT

config ZMK_KEYBOARD_NAME
	default "Small36"

config ZMK_SPLIT_ROLE_CENTRAL
	default y

endif

if SHIELD_SMALL36_LEFT || SHIELD_SMALL36_RIGHT

config ZMK_SPLIT
	default y

endif
```
